## Documentation/devicetree/bindings/display/panel/focaltech,ft8722.yaml
```yaml
# SPDX-License-Identifier: (GPL-2.0-only OR BSD-2-Clause)
%YAML 1.2
---
$id: http://devicetree.org/schemas/display/panel/focaltech,ft8722.yaml#
$schema: http://devicetree.org/meta-schemas/core.yaml#

title: Focaltech FT8722 LCD panel controller

maintainers:
  - Luka Panio <lukapanio@gmail.com>

allOf:
  - $ref: panel-common.yaml#

properties:
  compatible:
    const: txd,txdi660jbpv

  reg:
    maxItems: 1

  backlight: true
  port: true
  reset-gpios: true

  vddio-supply:
    description: power IC supply regulator

  vddpos-supply:
    description: positive boost supply regulator

  vddneg-supply:
    description: negative boost supply regulator

required:
  - compatible
  - reg
  - port
  - vddio-supply
  - vddpos-supply
  - vddneg-supply
  - reset-gpios

additionalProperties: false

examples:
  - |
    #include <dt-bindings/gpio/gpio.h>

    dsi {
        #address-cells = <1>;
        #size-cells = <0>;

        panel@0 {
            compatible = "txd,txdi660jbpv";
            reg = <0>;
            vddio-supply = <&vreg_l12c>;
            vddpos-supply = <&lab>;
            vddneg-supply = <&ibb>;
            reset-gpios = <&tlmm 44 GPIO_ACTIVE_HIGH>;

            backlight = <&aw99703_backlight>;
            pinctrl-0 = <&sde_dsi_active &sde_te_active_sleep>;
            pinctrl-1 = <&sde_dsi_sleep &sde_te_active_sleep>;
            pinctrl-names = "default", "sleep";

            port {
                panel_in: endpoint {
                    remote-endpoint = <&mdss_dsi0_out>;
                };
            };
        };
    };
```

## Documentation/devicetree/bindings/leds/backlight/awinic,aw99703.yaml
```yaml
# SPDX-License-Identifier: (GPL-2.0 OR BSD-2-Clause)
%YAML 1.2
---
$id: http://devicetree.org/schemas/leds/backlight/awinic,aw99703.yaml#
$schema: http://devicetree.org/meta-schemas/core.yaml#

title: Awinic AW99703 3-channel WLED Backlight Driver

maintainers:
  - Luka Panio <lukapanio0@gmail.com>

allOf:
  - $ref: common.yaml#

properties:
  compatible:
    const: awinic,aw99703

  reg:
    maxItems: 1

  enable-gpios:
    description: GPIO to use to enable/disable the backlight (HWEN pin).
    maxItems: 1

required:
  - compatible
  - reg
  - enable-gpios

unevaluatedProperties: false

examples:
  - |
    #include <dt-bindings/gpio/gpio.h>

    i2c {
        #address-cells = <1>;
        #size-cells = <0>;

        backlight@36 {
            compatible = "awinic,aw99703";
            reg = <0x36>;
            enable-gpios = <&pm8350c_gpios 7 GPIO_ACTIVE_HIGH>;
        };
    };

...
```

## drivers/input/touchscreen/focaltech_touch_ft3658u/Kconfig
```kconfig
#
# Focaltech Touchscreen driver configuration
#

config TOUCHSCREEN_FOCALTECH_FT3658U
	tristate "Focaltech Touchscreen"
	depends on I2C && OF
	default m
	help
	  Say Y here if you have Focaltech touch panel.
	  If unsure, say N.
```
