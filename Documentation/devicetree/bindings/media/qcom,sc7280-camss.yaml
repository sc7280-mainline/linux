## drivers/input/touchscreen/focaltech_touch/Kconfig
```kconfig
# Focaltech Touchscreen driver configuration

config TOUCHSCREEN_FTS_CORE
	tristate

config TOUCHSCREEN_FTS_SPI
	tristate "Focaltech SPI touchscreen"
	depends on SPI_MASTER
	select REGMAP
	select TOUCHSCREEN_FTS_CORE
	help
	  Say Y here if you have a Focaltech IC connected to
	  your system via SPI.

	  If unsure, say N.

	  To compile this driver as a module, choose M here: the
	  module will be called focaltech_spi.
```

## drivers/input/touchscreen/goodix_berlin_a_driver/Kconfig
```kconfig
#
# Goodix touchscreen driver configuration
#
menuconfig TOUCHSCREEN_GOODIX_BRL
	tristate "Goodix berlin touchscreen"
	help
	  Say Y here if you have a Goodix berlin series touch controller
	  to your system.
	  
	  If build module, say M.
	  If unsure, say N.

#if TOUCHSCREEN_GOODIX_BRL

config TOUCHSCREEN_GOODIX_BRL_SPI
	depends on TOUCHSCREEN_GOODIX_BRL
	bool "support SPI bus connection" 
	default n 
	help
		Say Y here if the touchscreen is connected via SPI bus.

#endif
```
